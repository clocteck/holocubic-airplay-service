## src/sdkconfig.defaults
```kconfig
CONFIG_IDF_TARGET="esp32s3"
CONFIG_ESPTOOLPY_FLASHSIZE_16MB=y

CONFIG_SPIRAM=y
CONFIG_SPIRAM_MODE_OCT=y
CONFIG_SPIRAM_SPEED_80M=y
CONFIG_SPIRAM_USE_MALLOC=y

CONFIG_AUDIO_DECODER_ALAC_SUPPORT=y
# CONFIG_AUDIO_DECODER_MP3_SUPPORT is not set
# CONFIG_AUDIO_DECODER_ADPCM_SUPPORT is not set
# CONFIG_AUDIO_DECODER_PCM_SUPPORT is not set
# CONFIG_AUDIO_ENCODER_ALAC_SUPPORT is not set
# CONFIG_AUDIO_ENCODER_ADPCM_SUPPORT is not set
# CONFIG_AUDIO_ENCODER_PCM_SUPPORT is not set
# CONFIG_AUDIO_SIMPLE_DEC_WAV_SUPPORT is not set
```
