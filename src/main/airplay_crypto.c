/*
 * Minimal self-contained crypto used by the AirPlay 1 compatibility module.
 * Author: sunfang1cn@gmail.com
 *
 * AirPlay 1 receivers all use the same, publicly documented 2048-bit RSA key.
 * Keeping only N, D and Montgomery R^2 avoids pulling a second OS/entropy layer
 * into the firmware-loaded shared object. RSA is used only for the legacy
 * Apple-Challenge response and RSA-OAEP unwrap required by RAOP.
 *
 * This is protocol compatibility code, not a general-purpose crypto API.
 */

#include "airplay_crypto.h"

#define RSA_LIMBS 64u
#define RSA_N0_INV 0x0b87054du

static const uint32_t RSA_N[RSA_LIMBS] = {
    0xbf98447bu, 0x117625cdu, 0x343ec782u, 0x5e0fc875u, 0xd8159782u, 0x18a6355bu, 0x56f8989eu, 0x562d4129u,
    0x7f4976c0u, 0x500687aau, 0x599a78bfu, 0x28f6559fu, 0x61372bb6u, 0x03eb3e6fu, 0xddf35996u, 0xdde698beu,
    0x3b5faa15u, 0x5c8943efu, 0xfb9a8befu, 0x8855dd8cu, 0x9fef1072u, 0x571a9c68u, 0x8adde409u, 0xeb06f8d0u,
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    0xbdd4dc68u, 0x2ce5f51cu, 0xaa8be6c6u, 0xa8fa7945u, 0x8eb70544u, 0x6c1f55a0u, 0xa2e2788bu, 0xe7d744f2u,
};

static const uint32_t RSA_D[RSA_LIMBS] = {
    0x5354f361u, 0x0dac68ccu, 0x8add4624u, 0xc880098eu, 0xa03f2f41u, 0xadc8b369u, 0x9d07106eu, 0xf2f37c0au,
    0xaca40bb6u, 0x79934a3du, 0xd60bdec4u, 0xa70933c2u, 0x32571fd8u, 0x849dcb33u, 0x51e9bf79u, 0xa17b44f0u,
    0x32377a0bu, 0x2a73d0b7u, 0xc7af43bfu, 0x68e69693u, 0x2b77628bu, 0xf2a0db92u, 0x706b58feu, 0x4041b867u,
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    0x187f9066u, 0x4ab27c0bu, 0x5acfcc7fu, 0x1743ec99u, 0x22aa84b0u, 0xb9a4ce41u, 0xf577d604u, 0xe5f00c72u,
};

static const uint32_t RSA_R2[RSA_LIMBS] = {
    0xd40e5ff8u, 0x32e78b17u, 0xe3d09755u, 0x6207b5d5u, 0xcac4c198u, 0x17a37930u, 0xef8c3bbeu, 0x447ffb24u,
    0xa1e016c7u, 0x38c9eda9u, 0xbff2008cu, 0x330600b6u, 0x4c9acfc9u, 0x6f7e53a2u, 0x48646eb8u, 0x35385a9cu,
    0xb363cb9bu, 0x77d142ebu, 0xcb0db18au, 0xcc906707u, 0xf44a8b42u, 0xefc61fa2u, 0xaedfd0d7u, 0xfd2ea54cu,
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    0x8ac44502u, 0xb69687ebu, 0xc8f8661du, 0x1848bcaau, 0x1d7d6a30u, 0x7dd178fbu, 0xe71417edu, 0x80c298dau,
};

static void bytes_zero(void *dst, size_t n)
{
    uint8_t *p = (uint8_t *)dst;
    while (n--) *p++ = 0;
}

static void bytes_copy(void *dst, const void *src, size_t n)
{
    uint8_t *d = (uint8_t *)dst;
    const uint8_t *s = (const uint8_t *)src;
    while (n--) *d++ = *s++;
}

static int limbs_ge(const uint32_t *a, const uint32_t *b)
{
    size_t i = RSA_LIMBS;
    while (i--) {
        if (a[i] > b[i]) return 1;
        if (a[i] < b[i]) return 0;
    }
    return 1;
}

static void limbs_sub(uint32_t *a, const uint32_t *b)
{
    uint64_t borrow = 0;
    size_t i;
    for (i = 0; i < RSA_LIMBS; ++i) {
        uint64_t bi = (uint64_t)b[i] + borrow;
        uint64_t ai = a[i];
        a[i] = (uint32_t)(ai - bi);
        borrow = (ai < bi) ? 1u : 0u;
    }
}

/* Coarsely integrated operand-scanning Montgomery multiplication. */
static void montgomery_mul(uint32_t out[RSA_LIMBS],
                           const uint32_t a[RSA_LIMBS],
                           const uint32_t b[RSA_LIMBS])
{
    uint32_t t[RSA_LIMBS + 1u];
    size_t i;
    bytes_zero(t, sizeof(t));

    for (i = 0; i < RSA_LIMBS; ++i) {
        uint64_t carry = 0;
        uint64_t z;
        uint32_t high;
        uint32_t m;
        size_t j;

        for (j = 0; j < RSA_LIMBS; ++j) {
            z = (uint64_t)t[j] + (uint64_t)a[j] * b[i] + carry;
            t[j] = (uint32_t)z;
            carry = z >> 32;
        }
        z = (uint64_t)t[RSA_LIMBS] + carry;
        t[RSA_LIMBS] = (uint32_t)z;
        high = (uint32_t)(z >> 32);

        m = t[0] * RSA_N0_INV;
        carry = 0;
        for (j = 0; j < RSA_LIMBS; ++j) {
            z = (uint64_t)t[j] + (uint64_t)m * RSA_N[j] + carry;
            if (j != 0) t[j - 1u] = (uint32_t)z;
            carry = z >> 32;
        }
        z = (uint64_t)t[RSA_LIMBS] + carry;
        t[RSA_LIMBS - 1u] = (uint32_t)z;
        t[RSA_LIMBS] = high + (uint32_t)(z >> 32);
    }

    if (t[RSA_LIMBS] || limbs_ge(t, RSA_N)) limbs_sub(t, RSA_N);
    for (i = 0; i < RSA_LIMBS; ++i) out[i] = t[i];
    bytes_zero(t, sizeof(t));
}

static void rsa_private_operation(const uint8_t input[AIRPLAY_RSA_BYTES],
                                  uint8_t output[AIRPLAY_RSA_BYTES])
{
    uint32_t x[RSA_LIMBS];
    uint32_t y[RSA_LIMBS];
    uint32_t tmp[RSA_LIMBS];
    uint32_t one[RSA_LIMBS];
    int bit;
    size_t i;

    bytes_zero(x, sizeof(x));
    bytes_zero(one, sizeof(one));
    one[0] = 1u;
    for (i = 0; i < AIRPLAY_RSA_BYTES; ++i) {
        size_t from_end = AIRPLAY_RSA_BYTES - 1u - i;
        x[i >> 2] |= (uint32_t)input[from_end] << ((i & 3u) * 8u);
    }

    montgomery_mul(tmp, x, RSA_R2);
    montgomery_mul(y, one, RSA_R2);
    for (bit = 2047; bit >= 0; --bit) {
        montgomery_mul(x, y, y);
        if ((RSA_D[(unsigned)bit >> 5] >> ((unsigned)bit & 31u)) & 1u) {
            montgomery_mul(y, x, tmp);
        } else {
            bytes_copy(y, x, sizeof(y));
        }
    }
    montgomery_mul(x, y, one);

    for (i = 0; i < AIRPLAY_RSA_BYTES; ++i) {
        output[AIRPLAY_RSA_BYTES - 1u - i] = (uint8_t)(x[i >> 2] >> ((i & 3u) * 8u));
    }
    bytes_zero(x, sizeof(x));
    bytes_zero(y, sizeof(y));
    bytes_zero(tmp, sizeof(tmp));
}

typedef struct sha1_ctx_t {
    uint32_t h[5];
    uint64_t total;
    uint8_t block[64];
    size_t used;
} sha1_ctx_t;

static uint32_t rol32(uint32_t v, unsigned n)
{
    return (v << n) | (v >> (32u - n));
}

static void sha1_transform(sha1_ctx_t *ctx, const uint8_t block[64])
{
    uint32_t w[80];
    uint32_t a, b, c, d, e;
    unsigned i;
    for (i = 0; i < 16; ++i) {
        const uint8_t *p = block + i * 4u;
        w[i] = ((uint32_t)p[0] << 24) | ((uint32_t)p[1] << 16) |
               ((uint32_t)p[2] << 8) | p[3];
    }
    for (i = 16; i < 80; ++i) w[i] = rol32(w[i - 3] ^ w[i - 8] ^ w[i - 14] ^ w[i - 16], 1);
    a = ctx->h[0]; b = ctx->h[1]; c = ctx->h[2]; d = ctx->h[3]; e = ctx->h[4];
    for (i = 0; i < 80; ++i) {
        uint32_t f, k, t;
        if (i < 20) { f = (b & c) | ((~b) & d); k = 0x5a827999u; }
        else if (i < 40) { f = b ^ c ^ d; k = 0x6ed9eba1u; }
        else if (i < 60) { f = (b & c) | (b & d) | (c & d); k = 0x8f1bbcdcu; }
        else { f = b ^ c ^ d; k = 0xca62c1d6u; }
        t = rol32(a, 5) + f + e + k + w[i];
        e = d; d = c; c = rol32(b, 30); b = a; a = t;
    }
    ctx->h[0] += a; ctx->h[1] += b; ctx->h[2] += c; ctx->h[3] += d; ctx->h[4] += e;
    bytes_zero(w, sizeof(w));
}

static void sha1_init(sha1_ctx_t *ctx)
{
    ctx->h[0] = 0x67452301u; ctx->h[1] = 0xefcdab89u; ctx->h[2] = 0x98badcfeu;
    ctx->h[3] = 0x10325476u; ctx->h[4] = 0xc3d2e1f0u;
    ctx->total = 0; ctx->used = 0;
}

static void sha1_update(sha1_ctx_t *ctx, const uint8_t *data, size_t len)
{
    ctx->total += len;
    while (len) {
        size_t take = 64u - ctx->used;
        if (take > len) take = len;
        bytes_copy(ctx->block + ctx->used, data, take);
        ctx->used += take; data += take; len -= take;
        if (ctx->used == 64u) { sha1_transform(ctx, ctx->block); ctx->used = 0; }
    }
}

static void sha1_final(sha1_ctx_t *ctx, uint8_t digest[20])
{
    uint64_t bits = ctx->total * 8u;
    unsigned i;
    ctx->block[ctx->used++] = 0x80;
    if (ctx->used > 56u) {
        while (ctx->used < 64u) ctx->block[ctx->used++] = 0;
        sha1_transform(ctx, ctx->block); ctx->used = 0;
    }
    while (ctx->used < 56u) ctx->block[ctx->used++] = 0;
    for (i = 0; i < 8; ++i) ctx->block[63u - i] = (uint8_t)(bits >> (i * 8u));
    sha1_transform(ctx, ctx->block);
    for (i = 0; i < 5; ++i) {
        digest[i * 4u] = (uint8_t)(ctx->h[i] >> 24);
        digest[i * 4u + 1u] = (uint8_t)(ctx->h[i] >> 16);
        digest[i * 4u + 2u] = (uint8_t)(ctx->h[i] >> 8);
        digest[i * 4u + 3u] = (uint8_t)ctx->h[i];
    }
    bytes_zero(ctx, sizeof(*ctx));
}

void airplay_sha1(const uint8_t *data, size_t len, uint8_t digest[20])
{
    sha1_ctx_t ctx;
    sha1_init(&ctx);
    if (data && len) sha1_update(&ctx, data, len);
    sha1_final(&ctx, digest);
}

static void mgf1_sha1(const uint8_t *seed, size_t seed_len, uint8_t *out, size_t out_len)
{
    uint32_t counter = 0;
    size_t pos = 0;
    while (pos < out_len) {
        sha1_ctx_t ctx;
        uint8_t digest[20];
        uint8_t c[4];
        size_t take = out_len - pos;
        if (take > sizeof(digest)) take = sizeof(digest);
        c[0] = (uint8_t)(counter >> 24); c[1] = (uint8_t)(counter >> 16);
        c[2] = (uint8_t)(counter >> 8); c[3] = (uint8_t)counter;
        sha1_init(&ctx); sha1_update(&ctx, seed, seed_len); sha1_update(&ctx, c, sizeof(c)); sha1_final(&ctx, digest);
        bytes_copy(out + pos, digest, take);
        bytes_zero(digest, sizeof(digest));
        pos += take; counter++;
    }
}

int airplay_rsa_pkcs1_sign_raw(const uint8_t *data,
                               size_t len,
                               uint8_t output[AIRPLAY_RSA_BYTES])
{
    uint8_t em[AIRPLAY_RSA_BYTES];
    size_t pad;
    if (!data || !output || len > AIRPLAY_RSA_BYTES - 11u) return 0;
    pad = AIRPLAY_RSA_BYTES - len - 3u;
    em[0] = 0; em[1] = 1;
    {
        size_t i;
        for (i = 0; i < pad; ++i) em[2u + i] = 0xff;
    }
    em[2u + pad] = 0;
    bytes_copy(em + 3u + pad, data, len);
    rsa_private_operation(em, output);
    bytes_zero(em, sizeof(em));
    return 1;
}

int airplay_rsa_oaep_decrypt(const uint8_t cipher[AIRPLAY_RSA_BYTES],
                             uint8_t *output,
                             size_t output_capacity,
                             size_t *output_len)
{
    uint8_t em[AIRPLAY_RSA_BYTES];
    uint8_t seed[20];
    uint8_t db[235];
    uint8_t mask[235];
    uint8_t empty_hash[20];
    size_t i, pos;
    int ok = 1;
    if (!cipher || !output || !output_len) return 0;
    *output_len = 0;
    rsa_private_operation(cipher, em);
    if (em[0] != 0) ok = 0;
    mgf1_sha1(em + 21u, 235u, seed, sizeof(seed));
    for (i = 0; i < sizeof(seed); ++i) seed[i] ^= em[1u + i];
    mgf1_sha1(seed, sizeof(seed), mask, sizeof(mask));
    for (i = 0; i < sizeof(db); ++i) db[i] = em[21u + i] ^ mask[i];
    airplay_sha1(NULL, 0, empty_hash);
    for (i = 0; i < sizeof(empty_hash); ++i) if (db[i] != empty_hash[i]) ok = 0;
    pos = sizeof(empty_hash);
    while (pos < sizeof(db) && db[pos] == 0) ++pos;
    if (pos >= sizeof(db) || db[pos] != 1) ok = 0;
    else ++pos;
    if (!ok || sizeof(db) - pos > output_capacity) {
        bytes_zero(em, sizeof(em)); bytes_zero(seed, sizeof(seed)); bytes_zero(db, sizeof(db));
        bytes_zero(mask, sizeof(mask)); return 0;
    }
    *output_len = sizeof(db) - pos;
    bytes_copy(output, db + pos, *output_len);
    bytes_zero(em, sizeof(em)); bytes_zero(seed, sizeof(seed)); bytes_zero(db, sizeof(db));
    bytes_zero(mask, sizeof(mask));
    return 1;
}

static const uint8_t AES_SBOX[256] = {
    0x63,0x7c,0x77,0x7b,0xf2,0x6b,0x6f,0xc5,0x30,0x01,0x67,0x2b,0xfe,0xd7,0xab,0x76,
    0xca,0x82,0xc9,0x7d,0xfa,0x59,0x47,0xf0,0xad,0xd4,0xa2,0xaf,0x9c,0xa4,0x72,0xc0,
    0xb7,0xfd,0x93,0x26,0x36,0x3f,0xf7,0xcc,0x34,0xa5,0xe5,0xf1,0x71,0xd8,0x31,0x15,
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    0x8c,0xa1,0x89,0x0d,0xbf,0xe6,0x42,0x68,0x41,0x99,0x2d,0x0f,0xb0,0x54,0xbb,0x16
};

static const uint8_t AES_INV_SBOX[256] = {
    0x52,0x09,0x6a,0xd5,0x30,0x36,0xa5,0x38,0xbf,0x40,0xa3,0x9e,0x81,0xf3,0xd7,0xfb,
    0x7c,0xe3,0x39,0x82,0x9b,0x2f,0xff,0x87,0x34,0x8e,0x43,0x44,0xc4,0xde,0xe9,0xcb,
    0x54,0x7b,0x94,0x32,0xa6,0xc2,0x23,0x3d,0xee,0x4c,0x95,0x0b,0x42,0xfa,0xc3,0x4e,
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    0x17,0x2b,0x04,0x7e,0xba,0x77,0xd6,0x26,0xe1,0x69,0x14,0x63,0x55,0x21,0x0c,0x7d
};

static const uint8_t AES_INV_MUL[4][256] = {
    {
        0x00u, 0x09u, 0x12u, 0x1bu, 0x24u, 0x2du, 0x36u, 0x3fu, 0x48u, 0x41u, 0x5au, 0x53u, 0x6cu, 0x65u, 0x7eu, 0x77u,
        0x90u, 0x99u, 0x82u, 0x8bu, 0xb4u, 0xbdu, 0xa6u, 0xafu, 0xd8u, 0xd1u, 0xcau, 0xc3u, 0xfcu, 0xf5u, 0xeeu, 0xe7u,
        0x3bu, 0x32u, 0x29u, 0x20u, 0x1fu, 0x16u, 0x0du, 0x04u, 0x73u, 0x7au, 0x61u, 0x68u, 0x57u, 0x5eu, 0x45u, 0x4cu,
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        0x31u, 0x38u, 0x23u, 0x2au, 0x15u, 0x1cu, 0x07u, 0x0eu, 0x79u, 0x70u, 0x6bu, 0x62u, 0x5du, 0x54u, 0x4fu, 0x46u,
    },
    {
        0x00u, 0x0bu, 0x16u, 0x1du, 0x2cu, 0x27u, 0x3au, 0x31u, 0x58u, 0x53u, 0x4eu, 0x45u, 0x74u, 0x7fu, 0x62u, 0x69u,
        0xb0u, 0xbbu, 0xa6u, 0xadu, 0x9cu, 0x97u, 0x8au, 0x81u, 0xe8u, 0xe3u, 0xfeu, 0xf5u, 0xc4u, 0xcfu, 0xd2u, 0xd9u,
        0x7bu, 0x70u, 0x6du, 0x66u, 0x57u, 0x5cu, 0x41u, 0x4au, 0x23u, 0x28u, 0x35u, 0x3eu, 0x0fu, 0x04u, 0x19u, 0x12u,
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        0xcau, 0xc1u, 0xdcu, 0xd7u, 0xe6u, 0xedu, 0xf0u, 0xfbu, 0x92u, 0x99u, 0x84u, 0x8fu, 0xbeu, 0xb5u, 0xa8u, 0xa3u,
    },
    {
        0x00u, 0x0du, 0x1au, 0x17u, 0x34u, 0x39u, 0x2eu, 0x23u, 0x68u, 0x65u, 0x72u, 0x7fu, 0x5cu, 0x51u, 0x46u, 0x4bu,
        0xd0u, 0xddu, 0xcau, 0xc7u, 0xe4u, 0xe9u, 0xfeu, 0xf3u, 0xb8u, 0xb5u, 0xa2u, 0xafu, 0x8cu, 0x81u, 0x96u, 0x9bu,
        0xbbu, 0xb6u, 0xa1u, 0xacu, 0x8fu, 0x82u, 0x95u, 0x98u, 0xd3u, 0xdeu, 0xc9u, 0xc4u, 0xe7u, 0xeau, 0xfdu, 0xf0u,
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        0xdcu, 0xd1u, 0xc6u, 0xcbu, 0xe8u, 0xe5u, 0xf2u, 0xffu, 0xb4u, 0xb9u, 0xaeu, 0xa3u, 0x80u, 0x8du, 0x9au, 0x97u,
    },
    {
        0x00u, 0x0eu, 0x1cu, 0x12u, 0x38u, 0x36u, 0x24u, 0x2au, 0x70u, 0x7eu, 0x6cu, 0x62u, 0x48u, 0x46u, 0x54u, 0x5au,
        0xe0u, 0xeeu, 0xfcu, 0xf2u, 0xd8u, 0xd6u, 0xc4u, 0xcau, 0x90u, 0x9eu, 0x8cu, 0x82u, 0xa8u, 0xa6u, 0xb4u, 0xbau,
        0xdbu, 0xd5u, 0xc7u, 0xc9u, 0xe3u, 0xedu, 0xffu, 0xf1u, 0xabu, 0xa5u, 0xb7u, 0xb9u, 0x93u, 0x9du, 0x8fu, 0x81u,
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        0xd7u, 0xd9u, 0xcbu, 0xc5u, 0xefu, 0xe1u, 0xf3u, 0xfdu, 0xa7u, 0xa9u, 0xbbu, 0xb5u, 0x9fu, 0x91u, 0x83u, 0x8du,
    }
};


static void aes_expand_key(const uint8_t key[16], uint8_t round_key[176])
{
    static const uint8_t rcon[10] = {0x01,0x02,0x04,0x08,0x10,0x20,0x40,0x80,0x1b,0x36};
    unsigned generated = 16, r = 0, i;
    bytes_copy(round_key, key, 16);
    while (generated < 176) {
        uint8_t t[4];
        for (i = 0; i < 4; ++i) t[i] = round_key[generated - 4u + i];
        if ((generated & 15u) == 0) {
            uint8_t q = t[0]; t[0] = AES_SBOX[t[1]] ^ rcon[r++];
            t[1] = AES_SBOX[t[2]]; t[2] = AES_SBOX[t[3]]; t[3] = AES_SBOX[q];
        }
        for (i = 0; i < 4; ++i) {
            round_key[generated] = round_key[generated - 16u] ^ t[i]; generated++;
        }
    }
}

static void aes_inv_shift_rows(uint8_t s[16])
{
    uint8_t t;
    t=s[13]; s[13]=s[9]; s[9]=s[5]; s[5]=s[1]; s[1]=t;
    t=s[2]; s[2]=s[10]; s[10]=t; t=s[6]; s[6]=s[14]; s[14]=t;
    t=s[3]; s[3]=s[7]; s[7]=s[11]; s[11]=s[15]; s[15]=t;
}

static void aes_decrypt_block(const uint8_t input[16], uint8_t output[16], const uint8_t rk[176])
{
    uint8_t s[16];
    int round;
    unsigned i, c;
    for (i=0;i<16;++i) s[i]=input[i]^rk[160u+i];
    for (round=9;round>=1;--round) {
        aes_inv_shift_rows(s);
        for (i=0;i<16;++i) s[i]=AES_INV_SBOX[s[i]]^rk[(unsigned)round*16u+i];
        for (c=0;c<4;++c) {
            uint8_t *p=s+c*4u, a=p[0],b=p[1],d=p[2],e=p[3];
            p[0]=AES_INV_MUL[3][a]^AES_INV_MUL[1][b]^AES_INV_MUL[2][d]^AES_INV_MUL[0][e];
            p[1]=AES_INV_MUL[0][a]^AES_INV_MUL[3][b]^AES_INV_MUL[1][d]^AES_INV_MUL[2][e];
            p[2]=AES_INV_MUL[2][a]^AES_INV_MUL[0][b]^AES_INV_MUL[3][d]^AES_INV_MUL[1][e];
            p[3]=AES_INV_MUL[1][a]^AES_INV_MUL[2][b]^AES_INV_MUL[0][d]^AES_INV_MUL[3][e];
        }
    }
    aes_inv_shift_rows(s);
    for (i=0;i<16;++i) output[i]=AES_INV_SBOX[s[i]]^rk[i];
    bytes_zero(s,sizeof(s));
}

void airplay_aes128_cbc_decrypt(const uint8_t key[16],
                                const uint8_t iv[16],
                                const uint8_t *input,
                                uint8_t *output,
                                size_t len)
{
    airplay_aes128_context_t ctx;
    if (!key || !iv || !input || !output || (len & 15u)) return;
    airplay_aes128_init(&ctx, key);
    airplay_aes128_cbc_decrypt_ctx(&ctx, iv, input, output, len);
    bytes_zero(&ctx, sizeof(ctx));
}

void airplay_aes128_init(airplay_aes128_context_t *ctx, const uint8_t key[16])
{
    if (!ctx || !key) return;
    aes_expand_key(key, ctx->round_key);
}

void airplay_aes128_cbc_decrypt_ctx(const airplay_aes128_context_t *ctx,
                                    const uint8_t iv[16],
                                    const uint8_t *input,
                                    uint8_t *output,
                                    size_t len)
{
    uint8_t previous[16], block[16];
    size_t pos, i;
    if (!ctx || !iv || !input || !output || (len & 15u)) return;
    bytes_copy(previous, iv, 16);
    for (pos=0;pos<len;pos+=16) {
        aes_decrypt_block(input+pos,block,ctx->round_key);
        for(i=0;i<16;++i) output[pos+i]=block[i]^previous[i];
        bytes_copy(previous,input+pos,16);
    }
    bytes_zero(previous,sizeof(previous)); bytes_zero(block,sizeof(block));
}
